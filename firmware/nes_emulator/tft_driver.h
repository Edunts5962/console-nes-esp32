// tft_driver.h - classe TFTDriver : petite couche d'affichage utilisee par
// osd.cpp (logo, ancienne interface, image du jeu), au-dessus de TFT_eSPI
// (ecran ILI9341 320x240 en SPI).
//
// Le depot d'origine pilotait un ecran ST7789 "a la main" (commandes SPI
// brutes). TFTDriver garde la meme interface publique (init / fillScreen /
// pushImage / drawFilledRect / drawChar / drawString / drawNumber /
// color565) : osd.cpp n'a rien a savoir du pilote en dessous.
#ifndef TFT_DRIVER_H
#define TFT_DRIVER_H

#include <Arduino.h>
#include <TFT_eSPI.h>
#include "hw_config.h"

// Resolution reelle de cette carte. Le depot d'origine utilisait 280x240
// (ecran different, plus etroit) : ce changement de largeur ne demande aucun
// autre ajustement cote osd.cpp, le centrage de l'image NES (256 px de large)
// s'appuie deja sur la macro DISPLAY_WIDTH et se recalcule tout seul :
// (320-256)/2 = 32 px de marge de chaque cote au lieu de (280-256)/2 = 12 px.
#define DISPLAY_WIDTH  320
#define DISPLAY_HEIGHT 240

#define TFT_BLACK   0x0000
#define TFT_WHITE   0xFFFF
#define TFT_RED     0xF800
#define TFT_GREEN   0x07E0
#define TFT_BLUE    0x001F

// Police 5x7 bitmap - copiee telle quelle depuis le depot d'origine
// (aucune raison d'en changer, elle ne touche a aucune broche : c'est
// juste un tableau de donnees). Utilisee par drawChar() ci-dessous.
static const uint8_t font_5x7[] PROGMEM = {
    0x00, 0x00, 0x00, 0x00, 0x00, // 0x20 ' '
    0x00, 0x00, 0x5F, 0x00, 0x00, // 0x21 '!'
    0x00, 0x07, 0x00, 0x07, 0x00, // 0x22 '"'
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    0x00, 0x00, 0x00, 0x00, 0x00  // 0x7F DEL
};

// L'objet TFT_eSPI est cree une seule fois dans le .ino (my_lcd) et partage
// ici par reference externe.
extern TFT_eSPI my_lcd;

class TFTDriver {
  public:
    TFTDriver() {}

    void init() {
        my_lcd.init();
        my_lcd.setRotation(1);   // paysage 320x240
        my_lcd.fillScreen(TFT_BLACK);
    }

    void fillScreen(uint16_t color) {
        my_lcd.fillScreen(color);
    }

    // swap_bytes=true demande a TFT_eSPI (setSwapBytes(true)) d'inverser les deux
    // octets de chaque pixel a l'envoi. C'est ce qu'il faut pour des couleurs
    // RGB565 NORMALES (tft.color565(), TFT_RED = 0xF800...) : l'ESP32 range
    // l'octet de poids faible en premier en memoire, l'ecran attend l'octet de
    // poids fort en premier. Utilise pour les menus LVGL, le logo et l'image du
    // jeu (voir LCD_GAME_COLOR_FIX dans hw_config.h). swap_bytes=false : donnees
    // envoyees telles quelles, pour des couleurs DEJA inversees en memoire. (Dans
    // le pilote ST7789 du depot d'origine, ce parametre "preswapped" avait le
    // sens oppose : true = envoyer tel quel.)
    void pushImage(int x, int y, int w, int h, const uint16_t *data, bool swap_bytes = false) {
        my_lcd.setSwapBytes(swap_bytes);
        my_lcd.pushImage(x, y, w, h, data);
    }

    // Image du jeu (osd.cpp, vid_flush()) : tampon en RAM (PSRAM), couleurs
    // RGB565 normales, envoye comme pushImage(..., true). La difference : la
    // version "const" ci-dessus aboutit a la fonction de TFT_eSPI prevue pour
    // les images en memoire flash (PROGMEM), qui recopie chaque ligne dans un
    // tampon sur la pile avant de l'envoyer et laisse le bus SPI a l'arret
    // pendant chaque copie. Ici, la version "RAM" de TFT_eSPI envoie l'image
    // d'un seul bloc depuis le tampon (meme chemin d'envoi que les menus LVGL,
    // pushColors()).
    void pushFrame(int x, int y, int w, int h, uint16_t *data) {
        my_lcd.setSwapBytes(true);
        my_lcd.pushImage(x, y, w, h, data);
    }

    // Primitives supplementaires pour la refonte visuelle des ecrans (badges
    // de boutons ronds/pilule, interrupteurs de reglages, liste de jeux) -
    // simples enveloppes autour des fonctions deja fournies par TFT_eSPI
    // (fillCircle/drawCircle/fillRoundRect/ drawRoundRect/fillTriangle),
    // exactement comme drawFilledRect() plus bas enveloppe deja fillRect().
    // Rien de nouveau cote materiel/SPI : TFT_eSPI sait deja dessiner ces
    // formes, seule l'API manquait ici.
    void drawFilledCircle(int x, int y, int r, uint16_t color) {
        my_lcd.fillCircle(x, y, r, color);
    }

    void drawCircle(int x, int y, int r, uint16_t color) {
        my_lcd.drawCircle(x, y, r, color);
    }

    void drawFilledRoundRect(int x, int y, int w, int h, int radius, uint16_t color) {
        if (w <= 0 || h <= 0) return;
        my_lcd.fillRoundRect(x, y, w, h, radius, color);
    }

    void drawRoundRect(int x, int y, int w, int h, int radius, uint16_t color) {
        if (w <= 0 || h <= 0) return;
        my_lcd.drawRoundRect(x, y, w, h, radius, color);
    }

    void drawFilledTriangle(int x0, int y0, int x1, int y1, int x2, int y2, uint16_t color) {
        my_lcd.fillTriangle(x0, y0, x1, y1, x2, y2, color);
    }

    void drawFilledRect(int x, int y, int w, int h, uint16_t color) {
        if (w <= 0 || h <= 0) {
            return;
        }

        int x0 = max(0, x);
        int y0 = max(0, y);
        int x1 = min(DISPLAY_WIDTH - 1, x + w - 1);
        int y1 = min(DISPLAY_HEIGHT - 1, y + h - 1);

        if (x1 < x0 || y1 < y0) {
            return;
        }

        my_lcd.fillRect(x0, y0, x1 - x0 + 1, y1 - y0 + 1, color);
    }

    // drawChar/drawString/drawNumber : meme logique que le depot d'origine
    // (police font_5x7 dessinee a la main avec drawFilledRect), pour garder un
    // rendu de menu identique pixel pour pixel.
    void drawChar(int x, int y, char c, uint16_t fg, uint16_t bg, int scale = 1) {
        if (scale < 1) {
            scale = 1;
        }

        uint8_t idx = (c >= 0x20 && c <= 0x7F) ? static_cast<uint8_t>(c - 0x20) : static_cast<uint8_t>('?' - 0x20);
        const uint8_t *glyph = &font_5x7[idx * 5];

        for (int cy = 0; cy < 7; cy++) {
            for (int cx = 0; cx < 5; cx++) {
                uint8_t line = pgm_read_byte(&glyph[cx]);
                if (line & (1 << cy)) {
                    drawFilledRect(x + cx * scale, y + cy * scale, scale, scale, fg);
                } else {
                    drawFilledRect(x + cx * scale, y + cy * scale, scale, scale, bg);
                }
            }
        }
    }

    void drawNumber(int x, int y, int num, uint16_t fg, uint16_t bg, int scale = 1) {
        if (num < 0) num = 0;
        char buf[10];
        sprintf(buf, "%d", num);

        int px = x;
        for (int i = 0; buf[i] != '\0'; i++) {
            drawChar(px, y, buf[i], fg, bg, scale);
            px += (5 + 1) * scale;
        }
    }

    void drawString(int x, int y, const char *str, uint16_t fg, uint16_t bg, int scale = 1) {
        int px = x;
        for (int i = 0; str[i] != '\0'; i++) {
            drawChar(px, y, str[i], fg, bg, scale);
            px += (5 + 1) * scale;
        }
    }

    static uint16_t color565(uint8_t r, uint8_t g, uint8_t b) {
        return ((r & 0xF8) << 8) | ((g & 0xFC) << 3) | (b >> 3);
    }
};
#endif
